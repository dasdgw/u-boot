## board/chumby/mx23_chumby/Kconfig
```kconfig
if TARGET_MX23_CHUMBY

config SYS_BOARD
	default "mx23_chumby"

config SYS_VENDOR
	default "chumby"

config SYS_SOC
	default "mxs"

config SYS_CONFIG_NAME
	default "mx23_chumby"

endif
```

## configs/mx23_chumby_defconfig
```kconfig
CONFIG_ARM=y
CONFIG_ARCH_MX23=y
CONFIG_SYS_TEXT_BASE=0x40008000
CONFIG_SPL_GPIO_SUPPORT=y
CONFIG_SPL_LIBCOMMON_SUPPORT=y
CONFIG_SPL_LIBGENERIC_SUPPORT=y
CONFIG_TARGET_MX23_CHUMBY=y
CONFIG_SPL_SERIAL_SUPPORT=y
CONFIG_SPL=n
CONFIG_NR_DRAM_BANKS=1
CONFIG_BOOTDELAY=3
CONFIG_VERSION_VARIABLE=y
# CONFIG_DISPLAY_BOARDINFO is not set
CONFIG_ARCH_MISC_INIT=y
# CONFIG_SPL_FRAMEWORK is not set
CONFIG_HUSH_PARSER=y
# CONFIG_CMD_FLASH is not set
CONFIG_CMD_GPIO=y
CONFIG_CMD_MMC=y
CONFIG_CMD_USB=y
# CONFIG_CMD_SETEXPR is not set
CONFIG_CMD_DHCP=n
CONFIG_CMD_CACHE=y
CONFIG_CMD_EXT2=y
CONFIG_CMD_EXT4=y
CONFIG_CMD_FAT=y
CONFIG_ENV_IS_IN_MMC=y
CONFIG_LED_STATUS=n
CONFIG_MMC_MXS=y
CONFIG_CONS_INDEX=0
CONFIG_USB=y
CONFIG_USB_EHCI_HCD=y
CONFIG_USB_STORAGE=y
CONFIG_USB_HOST_ETHER=n
CONFIG_OF_LIBFDT=y
CONFIG_EXTRA_ENV_SETTINGS=y
CONFIG_VIDEO=y
CONFIG_USE_BOOTARGS=y
```
